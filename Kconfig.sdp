## Kconfig.sdp
```kconfig
# Licensed to the Apache Software Foundation (ASF) under one
# or more contributor license agreements.  See the NOTICE file
# distributed with this work for additional information
# regarding copyright ownership.  The ASF licenses this file
# to you under the Apache License, Version 2.0 (the
# "License"); you may not use this file except in compliance
# with the License.  You may obtain a copy of the License at
#
#  http://www.apache.org/licenses/LICENSE-2.0
#
# Unless required by applicable law or agreed to in writing,
# software distributed under the License is distributed on an
# "AS IS" BASIS, WITHOUT WARRANTIES OR CONDITIONS OF ANY
# KIND, either express or implied.  See the License for the
# specific language governing permissions and limitations
# under the License.

config SDP
	bool "Linaro secure data pipeline for Zephyr"
	help
	  This option enables the Linaro secure data pipeline library.

if SDP

config SDP_SHELL
	bool "Enable the 'sdp' shell command"
	default n
	depends on SHELL
	help
	  Enabling this option will make the 'sdp' shell command available.

config SDP_POOL_SIZE
	int "Measurement pool heap size (in bytes)"
	default 2048
	help
	  Determines the heap size for the measurement pool (in bytes).

config SDP_FILTER_CACHE
	bool "Enable filter evaluation caching"
	default y
	help
		Enables caching of filter evaluation results when determining if a
		processor or sink node should be assigned an incoming datasample.
		Enabling filter evaluation caching may help avoid expensive reptitive
		'evaluate' calls.

config SDP_FILTER_CACHE_DEPTH
	int "Records to store in the filter evaluation cache FIFO."
	default 16
	help
		Indicates the number of filter evaluations to maintain in the cache
		FIFO. If previously uncached values are encountered, and the cache is
		full, the least recently used value will be removed from the cache.
		Each cache entry requires 20 bytes of memory. The ideal cache size is
		the number of processor nodes (or node chains) in the registry,
		multiplied by the number of unique measurement 'filter' values to be
		processed.

config SDP_PROC_MGR_NODE_LIMIT
	int "Maximum number of processor nodes that can be registered."
	default 8
	range 1 255
	help
	  Determines the maximum number of processor nodes than can be registered
	  in the processor manager. Requires SDP_PROC_MGR_NODE_LIMIT * 12 bytes
	  memory.

config SDP_PROC_MGR_POLL_RATE
	int "Rate in Hz to poll the measurement pool."
	default 10
	range 0 100
	help
	  Determines the rate, in Hz, that the processor node manager should poll
	  the measurement sample pool for new, unprocessed messages. Setting this
	  to 0 will disable automatic polling, requiring measurements to be
	  manually removed from the pool and sent to the sdp_pm_process function.

config SDP_PROC_MGR_PRIORITY
	int "Priority level for the polling thread."
	default 7
	help
	  Sets the priority level for the polling thread that is created when
	  SDP_PROC_MGR_POLL_RATE is > 0. A positive value indicates that this is
	  a preemptible thread, and a negative value indicates that this is a
	  cooperative thread. The higher the value, the lower the thread priority.

config SDP_PROC_MGR_STACK_SIZE
	int "Stack size for the polling thread."
	default 512
	help
	  Sets the stack size for the polling thread that is created when
	  SDP_PROC_MGR_POLL_RATE is > 0. When enabled, all processor nodes will be
	  executed in this thread. Be sure to allocate enough memory to take into
	  account the requirements of the largest processor node chain in the
	  pipeline.

endif
```

## Kconfig.step
```kconfig
# Licensed to the Apache Software Foundation (ASF) under one
# or more contributor license agreements.  See the NOTICE file
# distributed with this work for additional information
# regarding copyright ownership.  The ASF licenses this file
# to you under the Apache License, Version 2.0 (the
# "License"); you may not use this file except in compliance
# with the License.  You may obtain a copy of the License at
#
#  http://www.apache.org/licenses/LICENSE-2.0
#
# Unless required by applicable law or agreed to in writing,
# software distributed under the License is distributed on an
# "AS IS" BASIS, WITHOUT WARRANTIES OR CONDITIONS OF ANY
# KIND, either express or implied.  See the License for the
# specific language governing permissions and limitations
# under the License.

config STEP
	bool "Linaro secure telemetry pipeline for Zephyr"
	help
	  This option enables the Linaro secure telemery pipeline library.

if STEP

config STEP_INSTRUMENTATION
	bool "Enable basic code insrumentation for STEP"
	default n
	help
	  Enables basic code instrumentation in STeP.

config STEP_POOL_SIZE
	int "Measurement pool heap size (in bytes)"
	default 2048
	help
	  Determines the heap size for the measurement pool (in bytes).

config STEP_FILTER_CACHE
	bool "Enable filter evaluation caching"
	default n
	help
		Enables caching of filter evaluation results when determining if a
		processor node should be assigned an incoming datasample.
		Enabling filter evaluation caching may help avoid expensive reptitive
		'evaluate' calls, but can also have a negative effect since adding
		records to the cache has some overhead. Instrumention tests should be
		performed to decide if caching is beneficial or not.

config STEP_FILTER_CACHE_DEPTH
	int "Records to store in the filter evaluation cache FIFO."
	default 16
	help
		Indicates the number of filter evaluations to maintain in the cache
		FIFO. If previously uncached values are encountered, and the cache is
		full, the least recently used value will be removed from the cache.
		Each cache entry requires 20 bytes of memory. The ideal cache size is
		the number of processor nodes (or node chains) in the registry,
		multiplied by the number of unique measurement 'filter' values to be
		processed.

config STEP_PROC_MGR_NODE_LIMIT
	int "Maximum number of processor nodes that can be registered."
	default 8
	range 1 255
	help
	  Determines the maximum number of processor nodes than can be registered
	  in the processor manager. Requires STEP_PROC_MGR_NODE_LIMIT * 16 bytes
	  memory wihout instrumentation, or STEP_PROC_MGR_NODE_LIMIT * 24 if
	  CONFIG_STEP_INSTRUMENTATION is enabled.

config STEP_PROC_MGR_EVENT_DRIVEN
	bool "Enables the process manager to be event driven"
	default n
	help
	  This option makes the processor manager background thread
	  execute in an event driven fashion.  A single measurement in
	  the FIFO in a pending state will cause the thread to trigger.
	  When enabled, the pipeline execution rate will be determined
	  by the sensor data througput.

config STEP_PROC_MGR_POLL_RATE
	int "Rate in Hz to poll the measurement pool."
	default 0 if STEP_PROC_MGR_EVENT_DRIVEN
	default 10 
	range 0 100
	help
	  Determines the rate, in Hz, that the processor node manager should poll
	  the measurement sample pool for new, unprocessed messages. Setting this
	  to 0 will disable automatic polling, requiring measurements to be
	  manually removed from the pool and sent to the step_pm_process function.

config STEP_PROC_MGR_PRIORITY
	int "Priority level for the polling thread."
	default 0 if STEP_PROC_MGR_EVENT_DRIVEN
	default 7
	help
	  Sets the priority level for the polling thread that is created when
	  STEP_PROC_MGR_POLL_RATE is > 0. A positive value indicates that this is
	  a preemptible thread, and a negative value indicates that this is a
	  cooperative thread. The higher the value, the lower the thread priority.

config STEP_PROC_MGR_STACK_SIZE
	int "Stack size for the polling thread."
	default 512
	help
	  Sets the stack size for the polling thread that is created when
	  STEP_PROC_MGR_POLL_RATE is > 0. When enabled, all processor nodes will be
	  executed in this thread. Be sure to allocate enough memory to take into
	  account the requirements of the largest processor node chain in the
	  pipeline.

config STEP_PROC_MGR_CALLBACKS_NUM
	int "Maximum number of callbacks available to allocate"
	default 32
	help
	  Sets the maximum number of callbacks that the processor manager
	  can allocate from its memory pool.

endif
```

## west.yml
```yaml
# Copyright (c) 2022 Linaro
# SPDX-License-Identifier: Apache-2.0

manifest:
  self:
    path: step

  remotes:
    - name: zephyrproject-rtos
      url-base: https://github.com/zephyrproject-rtos

  projects:
    - name: zephyr
      remote: zephyrproject-rtos
      revision: main
      import: true
```
