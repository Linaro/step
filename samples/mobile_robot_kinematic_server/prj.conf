## CMakeLists.txt
```
cmake_minimum_required(VERSION 3.20.0)
# Copyright (c) 2018 Nordic Semiconductor ASA
# Copyright (c) 2022 Linaro Limited
#
# SPDX-License-Identifier: Apache-2.0
#

set(REMOTE_ZEPHYR_DIR ${CMAKE_CURRENT_BINARY_DIR}/openamp_remote-prefix/src/openamp_remote-build/zephyr)

if("${BOARD}" STREQUAL "lpcxpresso55s69_cpu0")
  set(BOARD_REMOTE "lpcxpresso55s69_cpu1")
elseif("${BOARD}" STREQUAL "mps2_an521")
  set(QEMU_EXTRA_FLAGS "-device;loader,file=${REMOTE_ZEPHYR_DIR}/zephyr.elf")
  set(BOARD_REMOTE "mps2_an521_remote")
else()
  message(FATAL_ERROR "${BOARD} was not supported for this sample")
endif()

message(STATUS "${BOARD} compile as Master in this sample")

find_package(Zephyr REQUIRED HINTS $ENV{ZEPHYR_BASE})
project(step_openamp)

enable_language(C ASM)

target_sources(app PRIVATE src/kinematic_node.c)
target_sources(app PRIVATE src/main.c)

include(ExternalProject)

ExternalProject_Add(
  openamp_remote
  SOURCE_DIR ${APPLICATION_SOURCE_DIR}/remote
  INSTALL_COMMAND ""      # This particular build system has no install command
  CMAKE_CACHE_ARGS -DBOARD:STRING=${BOARD_REMOTE}
  CMAKE_CACHE_ARGS -DDTC_OVERLAY_FILE:STRING=${DTC_OVERLAY_FILE}
  BUILD_BYPRODUCTS "${REMOTE_ZEPHYR_DIR}/${KERNEL_BIN_NAME}"
  # NB: Do we need to pass on more CMake variables?
  BUILD_ALWAYS True
)

target_include_directories(app PRIVATE ${CMAKE_CURRENT_SOURCE_DIR})
```

## Kconfig
```
# Private config options for multicore sample app

# Copyright (c) 2022 Linaro Limited
# SPDX-License-Identifier: Apache-2.0


config OPENAMP_IPC_SHM_BASE_ADDRESS
	hex
	default "$(dt_chosen_reg_addr_hex,$(DT_CHOSEN_Z_IPC_SHM))"
	help
	  This option specifies base address of the memory region to
	  be used for the OpenAMP IPC shared memory

source "Kconfig.zephyr"
```

## sample.yaml
```
sample:
  name: Secure telemetry pipeline multicore sample
tests:
  test:
    tags: step
```

## prj.conf
```kconfig
CONFIG_PRINTK=y
CONFIG_SERIAL=y
CONFIG_CBPRINTF_FP_SUPPORT=y

CONFIG_SHELL=y
CONFIG_SHELL_HISTORY=y
CONFIG_SHELL_VT100_COLORS=y

CONFIG_LOG=y
CONFIG_LOG_DEFAULT_LEVEL=4

CONFIG_STEP=y
CONFIG_STEP_PROC_MGR_STACK_SIZE=16384

# For the zephyr scientific library
CONFIG_ZSL=y
CONFIG_FPU=y
CONFIG_NEWLIB_LIBC=y

CONFIG_IPM=y
CONFIG_TIMESLICE_SIZE=1
CONFIG_MAIN_STACK_SIZE=2048
CONFIG_HEAP_MEM_POOL_SIZE=4096
CONFIG_RPMSG_SERVICE=y
CONFIG_RPMSG_SERVICE_MODE_MASTER=y
CONFIG_OPENAMP_SLAVE=n

# necessary to use CMSIS-DSP
CONFIG_NEWLIB_LIBC=y
CONFIG_CMSIS_DSP=y
CONFIG_CMSIS_DSP_FASTMATH=y
CONFIG_CMSIS_DSP_CONTROLLER=y
```

## src/main.c
```c
/*
 * Copyright (c) 2022 Linaro
 *
 * SPDX-License-Identifier: Apache-2.0
 */

#include <zephyr/kernel.h>
#include <zephyr/drivers/ipm.h>
#include <zephyr/device.h>
#include <zephyr/init.h>
#include <zephyr/shell/shell.h>

#include <step/step.h>
#include <step/proc_mgr.h>
#include <step/sample_pool.h>

#include <stdlib.h>
#include <string.h>
#include <math.h>
#include "kinematic_node.h"

static const struct step_mes_header joints_rpm_header = {
	/* Filter word. */
	.filter = {
		.base_type = STEP_MES_TYPE_VELOCITY,
		.flags = {
			.data_format = STEP_MES_FORMAT_NONE,
			.encoding = STEP_MES_ENCODING_NONE,
			.compression = STEP_MES_COMPRESSION_NONE,
			.timestamp = STEP_MES_TIMESTAMP_UPTIME_MS_32,
		},
	},
	/* SI Unit word. */
	.unit = {
		.si_unit = STEP_MES_UNIT_SI_RADIAN,
		.ctype = STEP_MES_UNIT_CTYPE_IEEE754_FLOAT32,
		.scale_factor = STEP_MES_SI_SCALE_NONE,
	},
	/* Source/Len word. */
	.srclen = {
		.len = sizeof(struct mobile_robot_node_payload),
		.fragment = 0,
		.sourceid = 0,
	}
};

static struct mobile_robot_node_payload payload;

void main(void)
{	
	int rc = 0;
	uint32_t handle;

	/* register the direct kinematic node*/
	rc = step_pm_register(node_chain, 0, &handle);
	if (rc) {
		printk("Node registration failed!\n");
		return;
	}
}

static int step_robot_cmd_kinematics(const struct shell *shell, size_t argc, char **argv)
{
	if (argc != 4) {
		return -EINVAL;
	}

	payload.kinematics.length_x = strtof(argv[1], NULL);
	payload.kinematics.length_y = strtof(argv[2], NULL);
	payload.kinematics.wheel_radius = strtof(argv[3], NULL) * 2.0f * 3.1416f;

	printk("Kinematics set Height: %f [mm], Width: %f [mm], %f Wheel Radius Scaled [mm] \n",
			payload.kinematics.length_x,
			payload.kinematics.length_y,
			payload.kinematics.wheel_radius);

	return 0;
}

static int step_robot_cmd_set_speeds(const struct shell *shell, size_t argc, char **argv)
{
	if (argc != 5) {
		return -EINVAL;
	}

	payload.command.joint_desired_speed_rpm[0] = strtof(argv[1], NULL);
	payload.command.joint_desired_speed_rpm[1] = strtof(argv[2], NULL);
	payload.command.joint_desired_speed_rpm[2] = strtof(argv[3], NULL);
	payload.command.joint_desired_speed_rpm[3] = strtof(argv[4], NULL);

	printk("Speed joint commmand vector: [ %f, %f, %f, %f] \n",
			payload.command.joint_desired_speed_rpm[0],
			payload.command.joint_desired_speed_rpm[1],
			payload.command.joint_desired_speed_rpm[2],
			payload.command.joint_desired_speed_rpm[3]);

	return 0;
}

static int step_robot_cmd_set_calculate(const struct shell *shell, size_t argc, char **argv)
{
	struct step_measurement *mes =  step_sp_alloc(sizeof(struct mobile_robot_node_payload));
	if(mes == NULL) {
		return -ENOMEM;
	}

	/* fill measurements information before publishing: */
	mes->header.filter_bits = joints_rpm_header.filter_bits;
	mes->header.unit_bits = joints_rpm_header.unit_bits;
	mes->header.srclen_bits = joints_rpm_header.srclen_bits;

	/* fill the measurement data with commands */
	memcpy(mes->payload, &payload, sizeof(struct mobile_robot_node_payload));

	step_pm_put(mes);

#if defined(CONFIG_SOC_MPS2_AN521)
	wakeup_cpu1();
	k_msleep(500);
#endif

	return 0;
}

/* Subcommand array for "step_foc" (level 1). */
SHELL_STATIC_SUBCMD_SET_CREATE(
	sub_step_robot,
	SHELL_CMD(kinematics, NULL, "Set robot base kinematics: Width[mm], Height[mm], and Wheel Radius[mm]", step_robot_cmd_kinematics),
	SHELL_CMD(set_speeds, NULL, "Set the four joints speeds[rpm] to obtain Kineamtics calculation", step_robot_cmd_set_speeds),
	SHELL_CMD(calculate, NULL, "Perform calculation with given parameters", step_robot_cmd_set_calculate),
	SHELL_SUBCMD_SET_END
	);

/* Root command "step_foc" (level 0). */
SHELL_CMD_REGISTER(step_robot, &sub_step_robot, "Secure telemetry pipeline Mobile Robot Kinematics commands", NULL);
```

## src/kinematic_node.c
```c
/*
 * Copyright (c) 2022 Linaro
 *
 * SPDX-License-Identifier: Apache-2.0
 */

#include <zephyr/kernel.h>
#include <zephyr/drivers/ipm.h>
#include <zephyr/sys/printk.h>
#include <zephyr/device.h>
#include <zephyr/init.h>
#include <zephyr/ipc/rpmsg_service.h>
#include <zephyr/logging/log.h>

#include <stdio.h>
#include <stdlib.h>
#include <string.h>
#include <step/proc_mgr.h>
#include "kinematic_node.h"

static int ep_id;
static struct mobile_robot_node_payload rx_payload;

int endpoint_cb(struct rpmsg_endpoint *ept, void *data,
		size_t len, uint32_t src, void *priv)
{
	memcpy(&rx_payload, data, len);

	printk("========= Calculated Kinematics for the Robot base: ============ \n");
	printk("Base length: %f [mm] \n", rx_payload.kinematics.length_x);
	printk("Base height: %f [mm] \n", rx_payload.kinematics.length_y);
	printk("Wheel Radius: %f [mm] \n", rx_payload.kinematics.wheel_radius);
	printk("========= Body Velocity from Direct Kinematics:  ============ \n");
	printk("Desired RPMs: %f, %f, %f, %f [rad/min] \n", rx_payload.command.joint_desired_speed_rpm[0],
													rx_payload.command.joint_desired_speed_rpm[1],
													rx_payload.command.joint_desired_speed_rpm[2],
													rx_payload.command.joint_desired_speed_rpm[3]);
	printk("Estimated Body Velocity[x,y, heading]: %f, %f, %f\n", rx_payload.body.linear_velocity_x,
																rx_payload.body.linear_velocity_y,
																rx_payload.body.heading);
	printk("========= Joint Speeds from Inverse Kinematics:  ============ \n");
	printk("Estimated Body Velocity in Local Core [x,y, heading]: %f, %f, %f \n", rx_payload.body.linear_velocity_x,
																				rx_payload.body.linear_velocity_y,
																				rx_payload.body.heading);
	printk("Output joint RPMs from Remote Core: %f, %f, %f, %f [rad/min] \n", rx_payload.joints.joint_speed_rpm[0],
																			rx_payload.joints.joint_speed_rpm[1],
																			rx_payload.joints.joint_speed_rpm[2],
																			rx_payload.joints.joint_speed_rpm[3]);
	printk("=====================================================================\n");

	return RPMSG_SUCCESS;
}

int do_process(struct step_measurement *mes, uint32_t handle, uint32_t inst)
{
	struct mobile_robot_node_payload *tx_payload = (struct mobile_robot_node_payload *)mes->payload;

	/* calculates the direct kinematics from the desired speed */
    float average_rps_x;
    float average_rps_y;
    float average_rps_a;

	/* obtain each axis rotation and scales to revolutions per second*/
    average_rps_x = ((tx_payload->command.joint_desired_speed_rpm[0] + 
					tx_payload->command.joint_desired_speed_rpm[1] +
					tx_payload->command.joint_desired_speed_rpm[2] +
					tx_payload->command.joint_desired_speed_rpm[3]) / 4) / 60;

    average_rps_y = ((-tx_payload->command.joint_desired_speed_rpm[0] + 
					tx_payload->command.joint_desired_speed_rpm[1] +
					tx_payload->command.joint_desired_speed_rpm[2] -
					tx_payload->command.joint_desired_speed_rpm[3]) / 4) / 60;
  
    average_rps_a = ((-tx_payload->command.joint_desired_speed_rpm[0] + 
					tx_payload->command.joint_desired_speed_rpm[1] -
					tx_payload->command.joint_desired_speed_rpm[2] +
					tx_payload->command.joint_desired_speed_rpm[3]) / 4) / 60;

    tx_payload->body.linear_velocity_x = average_rps_x * tx_payload->kinematics.wheel_radius;
	/* Only considered in case of a mecanum wheel */
    tx_payload->body.linear_velocity_y = average_rps_y * tx_payload->kinematics.wheel_radius;
    tx_payload->body.heading = (average_rps_y * tx_payload->kinematics.wheel_radius) /
							((tx_payload->kinematics.length_x / 2) +
							(tx_payload->kinematics.length_y / 2));

	/*pushes robot data to the remote core to perform the inverse kinematics calculation */
	rpmsg_service_send(ep_id, tx_payload, sizeof(struct mobile_robot_node_payload));

	return 0;
}

static int do_init(void *cfg, uint32_t handle, uint32_t inst)
{
	while (!rpmsg_service_endpoint_is_bound(ep_id)) {
		k_sleep(K_MSEC(1));
	}

	return 0;
}

void do_error_handler (struct step_measurement *mes,uint32_t handle, uint32_t inst, int error)
{
	printk("Kinematic node error code: %d \n", error);
}

/* Processor node chain. */
struct step_node node_chain_data[] = {
	/* Root processor node. */
	{
		.name = "Root sensor sample processor node",
		.filters = {
			.count = 1,
			.chain = (struct step_filter[]){
				{
					/* Phase (base type). */
					.match = STEP_MES_TYPE_VELOCITY,
					.ignore_mask = ~STEP_MES_MASK_FULL_TYPE,
				}
			},
		},

		/* Callbacks */
		.callbacks = {
			.init_handler = do_init,
			.exec_handler = do_process,
			.error_handler = do_error_handler,
		},

		/* Config settings */
		.config = NULL,

		/* Point to next processor node in chain. */
		.next = NULL,
	},
};

/* Pointer to node chain. */
struct step_node *node_chain = node_chain_data;

/* Make sure we register endpoint before RPMsg Service is initialized. */
int register_endpoint(const struct device *arg)
{
	int status;

	status = rpmsg_service_register_endpoint("step_ep", endpoint_cb);

	if (status < 0) {
		printk("rpmsg_create_ept failed %d\n", status);
		return status;
	}

	printk("rpmsg registered endpoint number: %d\n", status);

	ep_id = status;

	return 0;
}

SYS_INIT(register_endpoint, POST_KERNEL, CONFIG_RPMSG_SERVICE_EP_REG_PRIORITY);
```
