## CMakeLists.txt
```
cmake_minimum_required(VERSION 3.13.1)
include($ENV{ZEPHYR_BASE}/cmake/app/boilerplate.cmake NO_POLICY_SCOPE)
project(step_sub)

target_sources(app PRIVATE src/driver.c)
target_sources(app PRIVATE src/main.c)
target_sources(app PRIVATE src/nodes.c)
```

## sample.yaml
```
sample:
  name: Secure telemetry pipeline subscription example
tests:
  test:
    tags: step
```

## prj.conf
```kconfig
CONFIG_PRINTK=y
CONFIG_SERIAL=y
CONFIG_CBPRINTF_FP_SUPPORT=y

CONFIG_SHELL=y
CONFIG_SHELL_HISTORY=y
CONFIG_SHELL_VT100_COLORS=y

CONFIG_LOG=y
CONFIG_LOG_DEFAULT_LEVEL=4
CONFIG_LOG_MODE_DEFERRED=y

CONFIG_STEP=y
CONFIG_STEP_INSTRUMENTATION=y
```

## src/main.c
```c
/*
 * Copyright (c) 2021 Linaro
 *
 * SPDX-License-Identifier: Apache-2.0
 */

#include <zephyr/kernel.h>
#include <zephyr/shell/shell.h>
#include <zephyr/logging/log.h>
#include <step/sample_pool.h>
#include <step/proc_mgr.h>
#include <step/cache.h>
#include <step/instrumentation.h>
#include "driver.h"
#include "nodes.h"

static void on_node_completed(struct step_measurement *mes, uint32_t handle, void *user)
{
	struct drv_payload *p = mes->payload;
	printk("Receving subscription callback from node %d \n", handle);
	printk("Die temp: %10.6f [C] at %d [ms]\n", p->temp_c, p->timestamp);
	
	struct step_measurement *next_mes;
	step_shell_drv_get_mes(&next_mes);
	step_pm_put(next_mes);	
}

void main(void)
{
	uint32_t handle;
	struct step_measurement *mes;

	int rc = step_pm_register(test_node_chain, 0, &handle);
	if (rc) {
		printk("Node registration failed!\n");
		return;
	}

	/* subscribe to the registered node */
	rc = step_pm_subscribe_to_node(handle, on_node_completed, NULL);
	if (rc) {
		printk("Node subscription failed!\n");
		return;
	}

	/* generate the first sample, the callback will generate the others */
	rc = step_shell_drv_get_mes(&mes);
	if (rc) {
		printk("Node subscription failed!\n");
		return;
	}

	step_pm_put(mes);
	if (rc) {
		printk("Node subscription failed!\n");
		return;
	}
}
```

## src/driver.h
```c
/*
 * Copyright (c) 2021 Linaro
 *
 * SPDX-License-Identifier: Apache-2.0
 */

#ifndef STEP_SHELL_DRIVER_H__
#define STEP_SHELL_DRIVER_H__

#include <step/step.h>
#include <step/measurement/measurement.h>

#ifdef __cplusplus
extern "C" {
#endif

/**
 * @brief Payload struct for convenience sake.
 */
struct drv_payload {
	uint32_t timestamp;
	float temp_c;
};

/**
 * @brief Gets a populated measurement from the driver.
 * 
 * @param mes   Pointer to the @ref step_measurement placeholder pointer.
 * 
 * @return int  0 on success, otherwise a negative error code.
 * 
 * @note Double pointer required for @ref mes since the sample pool alloc
 *       function will change the measurement location in memory.
 */
int step_shell_drv_get_mes(struct step_measurement **mes);

#ifdef __cplusplus
}
#endif

#endif /* STEP_SHELL_DRIVER_H_ */
```

## src/nodes.c
```c
/*
 * Copyright (c) 2021 Linaro
 *
 * SPDX-License-Identifier: Apache-2.0
 */

#include <stdio.h>
#include <zephyr/kernel.h>
#include <step/proc_mgr.h>
#include "nodes.h"
#include "driver.h"

struct step_node_cb_stats cb_stats = { 0 };

/* Demonstrate how a custom config struct can be used with node callbacks. */
struct node_cfg {
	float mult;
} node_cfg_inst = {
	.mult = 10.0F,
};

/* Initialisation callback (fires when node added to registry). */
int node_init(void *cfg, uint32_t handle, uint32_t inst)
{
	cb_stats.init++;

	return 0;
}

/* Overrides the filter engine when evaluating this node. */
bool node_evaluate(struct step_measurement *mes, uint32_t handle, uint32_t inst)
{
	cb_stats.evaluate++;

	return true;
}

/* Fires when the filter engine has indicated a match for this node. */
bool node_matched(struct step_measurement *mes, uint32_t handle, uint32_t inst)
{
	cb_stats.matched++;

	return true;
}

/* Fires before the node runs. */
int node_start(struct step_measurement *mes, uint32_t handle, uint32_t inst)
{
	cb_stats.start++;

	return 0;
}

/* Main node processing function. */
int node_exec(struct step_measurement *mes, uint32_t handle, uint32_t inst)
{
	if (mes->header.filter.ext_type == STEP_MES_EXT_TYPE_TEMP_DIE) {
		struct step_node *node;
		float mult = 1.0F;

		/* Get a reference to the source node from the proc. node registry. */
		node = step_pm_node_get(handle, inst);
		if (node == NULL) {
			return -EINVAL;
		}

		/* Parse the config struct if present. */
		if (node->config != NULL) {
			struct node_cfg *c = node->config;
			mult = c->mult;
		}

		/* Display the timestamp and die temp value. */
		struct drv_payload *tp = mes->payload;
		tp->temp_c *= mult;
	} else {
		return -EINVAL;
	}

	cb_stats.run++;
	return 0;
}

/* Fires when the node has been successfully run. */
int node_stop(struct step_measurement *mes, uint32_t handle, uint32_t inst)
{
	cb_stats.stop++;

	return 0;
}

/* Fires when an error occurs running this node. */
void node_error(struct step_measurement *mes, uint32_t handle,
		uint32_t inst, int error)
{
	cb_stats.error++;
}

/* Processor node chain. */
struct step_node test_node_chain_data[] = {
	/* Root processor node. */
	{
		.name = "Root processor node",
		.filters = {
			.count = 3,
			.chain = (struct step_filter[]){
				{
					/* Temperature (base type). */
					.match = STEP_MES_TYPE_TEMPERATURE,
					.ignore_mask = ~STEP_MES_MASK_FULL_TYPE,
				},
				{
					/* Die temperature. */
					.op = STEP_FILTER_OP_OR,
					.match = STEP_MES_TYPE_TEMPERATURE +
						 (STEP_MES_EXT_TYPE_TEMP_DIE <<
						  STEP_MES_MASK_EXT_TYPE_POS),
					.ignore_mask = ~STEP_MES_MASK_FULL_TYPE,
				},
				{
					/* Make sure timestamp (bits 26-28) = UPTIME_MS_32 */
					.op = STEP_FILTER_OP_AND,
					.match = (STEP_MES_TIMESTAMP_UPTIME_MS_32 <<
						  STEP_MES_MASK_TIMESTAMP_POS),
					.ignore_mask = ~STEP_MES_MASK_TIMESTAMP,
				},
			},
		},

		/* Callbacks */
		.callbacks = {
			.init_handler = node_init,
			.evaluate_handler = NULL,
			.matched_handler = node_matched,
			.start_handler = node_start,
			.stop_handler = node_stop,
			.exec_handler = node_exec,
			.error_handler = node_error,
		},

		/* Config settings */
		.config = NULL,

		/* Point to next processor node in chain. */
		.next = &test_node_chain_data[1]
	},

	/* Processor node 1. */
	{
		.name = "2nd processor node",
		/* Callbacks */
		.callbacks = {
			.init_handler = node_init,
			.exec_handler = node_exec,
			.error_handler = node_error,
		},

		/* Config settings (multiplication factor) */
		.config = &node_cfg_inst,

		/* Point to next processor node in chain. */
		.next = &test_node_chain_data[2]
	},

	/* Processor node 2. */
	{
		.name = "3rd processor node",
		/* Callbacks */
		.callbacks = {
			.init_handler = node_init,
			.exec_handler = node_exec,
			.error_handler = node_error,
		},

		/* Config settings */
		.config = NULL,

		/* End of the chain. */
		.next = NULL
	}
};

/* Pointer to node chain. */
struct step_node *test_node_chain = test_node_chain_data;
```
