## CMakeLists.txt
```
cmake_minimum_required(VERSION 3.13.1)
include($ENV{ZEPHYR_BASE}/cmake/app/boilerplate.cmake NO_POLICY_SCOPE)
project(step_shell)

target_sources(app PRIVATE src/driver.c)
target_sources(app PRIVATE src/main.c)
target_sources(app PRIVATE src/nodes.c)
```

## sample.yaml
```
sample:
  name: Secure telemetry pipeline shell example
tests:
  test:
    tags: step
```

## prj.conf
```kconfig
CONFIG_PRINTK=y
CONFIG_SERIAL=y
CONFIG_CBPRINTF_FP_SUPPORT=y

CONFIG_SHELL=y
CONFIG_SHELL_HISTORY=y
CONFIG_SHELL_VT100_COLORS=y

CONFIG_LOG=y
CONFIG_LOG_DEFAULT_LEVEL=4
CONFIG_LOG_MODE_DEFERRED=y

CONFIG_STEP=y
CONFIG_STEP_INSTRUMENTATION=y

# Set the polling rate to 0 to disable the polling thread, and manually
# send measurements to the node processing engine. This can lead to easier
# instrumentation than when the polling thread is enabled, since processing
# of measurements happens asynchronously in a separate thread, meaning two
# runtimes needs to be combined for the approximate total runtime.
#CONFIG_STEP_PROC_MGR_POLL_RATE=0
```

## src/main.c
```c
/*
 * Copyright (c) 2021 Linaro
 *
 * SPDX-License-Identifier: Apache-2.0
 */

#include <zephyr/kernel.h>
#include <zephyr/shell/shell.h>
#include <zephyr/logging/log.h>
#include <step/sample_pool.h>
#include <step/proc_mgr.h>
#include <step/cache.h>
#include <step/instrumentation.h>
#include "driver.h"
#include "nodes.h"

#define LOG_LEVEL LOG_LEVEL_DBG
LOG_MODULE_REGISTER(step_shell);

/**
 * @brief Instrumentation counter.
 */
static uint32_t _instr;

static int
step_shell_cmd_list(const struct shell *shell, size_t argc, char **argv)
{
	ARG_UNUSED(argc);
	ARG_UNUSED(argv);

	step_pm_list();

	return 0;
}

static int
step_shell_cmd_add(const struct shell *shell, size_t argc, char **argv)
{
	ARG_UNUSED(argc);
	ARG_UNUSED(argv);

	uint32_t handle = 0;

	/* Append a new instance of the node chain. */
	STEP_INSTR_START(_instr);
	step_pm_register(test_node_chain, 4, &handle);
	STEP_INSTR_STOP(_instr);

	/* step_node_print(test_node_chain); */

#if CONFIG_STEP_INSTRUMENTATION
	LOG_DBG("Took %d ns", _instr);
#endif

	return 0;
}

static int
step_shell_cmd_clr(const struct shell *shell, size_t argc, char **argv)
{
	ARG_UNUSED(argc);
	ARG_UNUSED(argv);

	/* Reset the processor node registry. */
	STEP_INSTR_START(_instr);
	step_pm_clear();
	STEP_INSTR_STOP(_instr);

#if CONFIG_STEP_INSTRUMENTATION
	LOG_DBG("Took %d ns", _instr);
#endif

	return 0;
}

static int
step_shell_cmd_pub(const struct shell *shell, size_t argc, char **argv)
{
	ARG_UNUSED(argc);
	ARG_UNUSED(argv);

	int rc;
	struct step_measurement *mes = NULL;

	/* WARNING: The instrumention values below are incomplete.
	 *
	 * In the case where the polling thread is used to process the measurement
	 * (CONFIG_STEP_PROC_MGR_POLL_RATE > 0), what is being calculated is the
	 * time it takes to allocate memory from the sample pool and assign a new
	 * measurement to the FIFO. It doesn't include the PROCESSING time for that
	 * sample once it is removed from the FIFO by the polling thread.
	 *
	 * The second code block (CONFIG_STEP_PROC_MGR_POLL_RATE = 0) includes
	 * the execution time when processing the sample, since it happens in the
	 * same thread.
	 */

	STEP_INSTR_START(_instr);

	/* Get a measurement from the sample driver. */
	rc = step_shell_drv_get_mes(&mes);
	if (rc) {
		/* ToDo: Handle error. */
		LOG_WRN("Failed to allocate measurement in driver.");
	}

	/* Assign measurement to FIFO so polling thread finds it. */
	step_pm_put(mes);
	STEP_INSTR_STOP(_instr);

	LOG_DBG("Published 1 measurement");
	/* step_mes_print(smes); */

#if CONFIG_STEP_INSTRUMENTATION
	LOG_DBG("Took %d ns", _instr);
#endif

	return 0;
}

static int
step_shell_cmd_stats(const struct shell *shell, size_t argc, char **argv)
{
	ARG_UNUSED(argc);
	ARG_UNUSED(argv);

	shell_print(shell, "init:     %d", cb_stats.init);
	shell_print(shell, "evaluate: %d", cb_stats.evaluate);
	shell_print(shell, "matched:  %d", cb_stats.matched);
	shell_print(shell, "start:    %d", cb_stats.start);
	shell_print(shell, "run:      %d", cb_stats.run);
	shell_print(shell, "stop:     %d", cb_stats.stop);
	shell_print(shell, "error:    %d", cb_stats.error);

	return 0;
}

static int
step_shell_cmd_pool(const struct shell *shell, size_t argc, char **argv)
{
	ARG_UNUSED(argc);
	ARG_UNUSED(argv);

	step_sp_print_stats();

	return 0;
}

#if CONFIG_STEP_FILTER_CACHE
static int
step_shell_cmd_cache(const struct shell *shell, size_t argc, char **argv)
{
	ARG_UNUSED(argc);
	ARG_UNUSED(argv);

	shell_print(shell, "Cache slots:\n");
	step_cache_print();
	shell_print(shell, "\nStats:\n");
	step_cache_print_stats();

	return 0;
}
#endif

void main(void)
{
	printk("Type 'step help' for command options.\n\n");
	printk("1.) Populate the processor registry: step add\n");
	printk("2.) Publish measurement(s):          step pub\n");
	printk("3.) Check results:                   step stats");

	while (1) {
		k_sleep(K_FOREVER);
	}
}

/* Subcommand array for "step" (level 1). */
SHELL_STATIC_SUBCMD_SET_CREATE(
	sub_step,
	/* 'list' command handler. */
	SHELL_CMD(list, NULL, "Display proc. registry", step_shell_cmd_list),
	/* 'add' command handler. */
	SHELL_CMD(add, NULL, "Populate proc. registry", step_shell_cmd_add),
	/* 'clr' command handler. */
	SHELL_CMD(clr, NULL, "Clear proc. registry", step_shell_cmd_clr),
	/* 'pub' command handler. */
	SHELL_CMD(pub, NULL, "Publish a measurement", step_shell_cmd_pub),
	/* 'stats' command handler. */
	SHELL_CMD(stats, NULL, "Display node cb stats", step_shell_cmd_stats),
	/* 'pool' command handler. */
	SHELL_CMD(pool, NULL, "Display meas. pool stats", step_shell_cmd_pool),
#if CONFIG_STEP_FILTER_CACHE
	/* 'cache' command handler. */
	SHELL_CMD(cache, NULL, "Display cache stats", step_shell_cmd_cache),
#endif

	/* Array terminator. */
	SHELL_SUBCMD_SET_END
	);

/* Root command "step" (level 0). */
SHELL_CMD_REGISTER(step, &sub_step, "Secure telemetry pipeline commands", NULL);
```

## src/driver.c
```c
/*
 * Copyright (c) 2021 Linaro
 *
 * SPDX-License-Identifier: Apache-2.0
 */

#include <string.h>
#include <zephyr/kernel.h>
#include <zephyr/sys/printk.h>
#include <step/sample_pool.h>
#include <step/instrumentation.h>
#include "driver.h"

#define DRV_PAYLOAD_SZ      (sizeof(struct drv_payload))
#define DRV_PAYLOAD_SRC_ID  (2)

/**
 * @brief Pre-populated measurement header to copy into allocated measurements.
 */
static struct step_mes_header drv_header = {
	/* Filter word. */
	.filter = {
		.base_type = STEP_MES_TYPE_TEMPERATURE,
		.ext_type = STEP_MES_EXT_TYPE_TEMP_DIE,
		.flags = {
			.data_format = STEP_MES_FORMAT_NONE,
			.encoding = STEP_MES_ENCODING_NONE,
			.compression = STEP_MES_COMPRESSION_NONE,
			.timestamp = STEP_MES_TIMESTAMP_UPTIME_MS_32,
		},
	},
	/* SI Unit word. */
	.unit = {
		.si_unit = STEP_MES_UNIT_SI_DEGREE_CELSIUS,
		.ctype = STEP_MES_UNIT_CTYPE_IEEE754_FLOAT32,
		.scale_factor = STEP_MES_SI_SCALE_NONE,
	},
	/* Source/Len word. */
	.srclen = {
		.len = DRV_PAYLOAD_SZ,
		.fragment = 0,
		.sourceid = DRV_PAYLOAD_SRC_ID,
	}
};

int step_shell_drv_get_mes(struct step_measurement **mes)
{
	int rc = 0;

	/* Allocate measurement from the sample pool. */
	*mes = step_sp_alloc(DRV_PAYLOAD_SZ);
	if (*mes == NULL) {
		rc = -ENOMEM;
		goto err;
	}

	/* Copy the measurement header. */
	(*mes)->header.filter_bits = drv_header.filter_bits;
	(*mes)->header.unit_bits = drv_header.unit_bits;
	(*mes)->header.srclen_bits = drv_header.srclen_bits;

	/* Assign the payload. */
	struct drv_payload *payload = (*mes)->payload;
	payload->timestamp = k_uptime_get_32();
	payload->temp_c = 32.0F;

err:
	return rc;
}
```

## src/nodes.c
```c
/*
 * Copyright (c) 2021 Linaro
 *
 * SPDX-License-Identifier: Apache-2.0
 */

#include <stdio.h>
#include <zephyr/logging/log.h>
#include <step/proc_mgr.h>
#include "nodes.h"
#include "driver.h"

LOG_MODULE_DECLARE(step_shell);

struct step_node_cb_stats cb_stats = { 0 };

/* Demonstrate how a custom config struct can be used with node callbacks. */
struct node_cfg {
	float mult;
} node_cfg_inst = {
	.mult = 10.0F,
};

/* Initialisation callback (fires when node added to registry). */
int node_init(void *cfg, uint32_t handle, uint32_t inst)
{
	cb_stats.init++;

	return 0;
}

/* Overrides the filter engine when evaluating this node. */
bool node_evaluate(struct step_measurement *mes, uint32_t handle, uint32_t inst)
{
	cb_stats.evaluate++;

	return true;
}

/* Fires when the filter engine has indicated a match for this node. */
bool node_matched(struct step_measurement *mes, uint32_t handle, uint32_t inst)
{
	cb_stats.matched++;

	return true;
}

/* Fires before the node runs. */
int node_start(struct step_measurement *mes, uint32_t handle, uint32_t inst)
{
	cb_stats.start++;

	return 0;
}

/* Main node processing function. */
int node_exec(struct step_measurement *mes, uint32_t handle, uint32_t inst)
{
	if (mes->header.filter.ext_type == STEP_MES_EXT_TYPE_TEMP_DIE) {
		struct step_node *node;
		float mult = 1.0F;

		/* Get a reference to the source node from the proc. node registry. */
		node = step_pm_node_get(handle, inst);
		if (node == NULL) {
			return -EINVAL;
		}

		/* Parse the config struct if present. */
		if (node->config != NULL) {
			struct node_cfg *c = node->config;
			mult = c->mult;
			LOG_INF("cfg: mult by %.2f (handle %d:%d)", c->mult, handle, inst);
		}

		/* Display the timestamp and die temp value. */
		struct drv_payload *tp = mes->payload;
		tp->temp_c *= mult;
		LOG_INF("[%d] Received die temp: %0.2f C (handle %d:%d)",
			tp->timestamp, tp->temp_c, handle, inst);
	} else {
		LOG_WRN("Unexpected message type: base=%02X ext=%02X, handle %d:%d",
			mes->header.filter.base_type, mes->header.filter.ext_type,
			handle, inst);
		return -EINVAL;
	}

	cb_stats.run++;
	return 0;
}

/* Fires when the node has been successfully run. */
int node_stop(struct step_measurement *mes, uint32_t handle, uint32_t inst)
{
	cb_stats.stop++;

	return 0;
}

/* Fires when an error occurs running this node. */
void node_error(struct step_measurement *mes, uint32_t handle,
		uint32_t inst, int error)
{
	cb_stats.error++;
}

/* Processor node chain. */
struct step_node test_node_chain_data[] = {
	/* Root processor node. */
	{
		.name = "Root processor node",
		.filters = {
			.count = 3,
			.chain = (struct step_filter[]){
				{
					/* Temperature (base type). */
					.match = STEP_MES_TYPE_TEMPERATURE,
					.ignore_mask = ~STEP_MES_MASK_FULL_TYPE,
				},
				{
					/* Die temperature. */
					.op = STEP_FILTER_OP_OR,
					.match = STEP_MES_TYPE_TEMPERATURE +
						 (STEP_MES_EXT_TYPE_TEMP_DIE <<
						  STEP_MES_MASK_EXT_TYPE_POS),
					.ignore_mask = ~STEP_MES_MASK_FULL_TYPE,
				},
				{
					/* Make sure timestamp (bits 26-28) = UPTIME_MS_32 */
					.op = STEP_FILTER_OP_AND,
					.match = (STEP_MES_TIMESTAMP_UPTIME_MS_32 <<
						  STEP_MES_MASK_TIMESTAMP_POS),
					.ignore_mask = ~STEP_MES_MASK_TIMESTAMP,
				},
			},
		},

		/* Callbacks */
		.callbacks = {
			.init_handler = node_init,
			.evaluate_handler = NULL,
			.matched_handler = node_matched,
			.start_handler = node_start,
			.stop_handler = node_stop,
			.exec_handler = node_exec,
			.error_handler = node_error,
		},

		/* Config settings */
		.config = NULL,

		/* Point to next processor node in chain. */
		.next = &test_node_chain_data[1]
	},

	/* Processor node 1. */
	{
		.name = "2nd processor node",
		/* Callbacks */
		.callbacks = {
			.init_handler = node_init,
			.exec_handler = node_exec,
			.error_handler = node_error,
		},

		/* Config settings (multiplication factor) */
		.config = &node_cfg_inst,

		/* Point to next processor node in chain. */
		.next = &test_node_chain_data[2]
	},

	/* Processor node 2. */
	{
		.name = "3rd processor node",
		/* Callbacks */
		.callbacks = {
			.init_handler = node_init,
			.exec_handler = node_exec,
			.error_handler = node_error,
		},

		/* Config settings */
		.config = NULL,

		/* End of the chain. */
		.next = NULL
	}
};

/* Pointer to node chain. */
struct step_node *test_node_chain = test_node_chain_data;
```

## src/nodes.h
```c
/*
 * Copyright (c) 2021 Linaro
 *
 * SPDX-License-Identifier: Apache-2.0
 */

#ifndef STEP_SHELL_NODES_H__
#define STEP_SHELL_NODES_H__

#include <stdlib.h>
#include <stdbool.h>
#include <step/step.h>
#include <step/node.h>
#include <step/measurement/measurement.h>

#ifdef __cplusplus
extern "C" {
#endif

/* Struct to track the number of times specific callbacks are fired. */
struct step_node_cb_stats {
	uint32_t init;
	uint32_t evaluate;
	uint32_t matched;
	uint32_t start;
	uint32_t run;
	uint32_t stop;
	uint32_t error;
};

/* Defined in pnodes.c */
extern struct step_node_cb_stats cb_stats;
extern struct step_node *test_node_chain;

#ifdef __cplusplus
}
#endif

#endif /* STEP_SHELL_NODES_H_ */
```

## src/pnodes.c
```c
/*
 * Copyright (c) 2021 Linaro
 *
 * SPDX-License-Identifier: Apache-2.0
 */

#include <stdio.h>
#include <logging/log.h>
#include <step/proc_mgr.h>
#include "pnodes.h"

LOG_MODULE_DECLARE(step_shell);

struct step_node_cb_stats cb_stats = { 0 };

/* Die temperature with 32-bit timestamp payload. Must match struct in main.c*/
struct temp_payload {
	uint32_t timestamp;
	float temp_c;
};

/* Demonstrate how a custom config struct can be used with node callbacks. */
struct node_cfg {
	float mult;
} node_cfg_inst = {
	.mult = 10.0F,
};

bool node_evaluate(struct step_measurement *mes, uint32_t handle, uint32_t inst)
{
	/* Overrides the filter engine when evaluating this node. */
	cb_stats.evaluate++;

	return true;
}

bool node_matched(struct step_measurement *mes, uint32_t handle, uint32_t inst)
{
	/* Fires when the filter engine has indicated a match for this node. */
	cb_stats.matched++;

	return true;
}

int node_start(struct step_measurement *mes, uint32_t handle, uint32_t inst)
{
	/* Fires before the node runs. */
	cb_stats.start++;

	return 0;
}

int node_exec(struct step_measurement *mes, uint32_t handle, uint32_t inst)
{
	struct step_node *node;

	if (mes->header.filter.ext_type == STEP_MES_EXT_TYPE_TEMP_DIE) {
		float mult = 1.0F;
		
		/* Get a reference to the source node from the proc. node registry. */
		node = step_pm_node_get(handle, inst);
		if (node == NULL) {
			return -EINVAL;
		}

		/* Parse the config struct if present. */
		if (node->config != NULL) {
			struct node_cfg *c = node->config;
			mult = c->mult;
			LOG_INF("cfg: mult by %.2f (handle %d:%d)", c->mult, handle, inst);
		}

		/* Display the timestamp and die temp value. */
		struct temp_payload *tp = mes->payload;
		tp->temp_c *= mult;
		LOG_INF("[%d] Received die temp: %0.2f C (handle %d:%d)",
			tp->timestamp, tp->temp_c, handle, inst);
	} else {
		LOG_WRN("Unexpected message type: base=%02X ext=%02X, handle %d:%d",
			mes->header.filter.base_type, mes->header.filter.ext_type,
			handle, inst);
		return -EINVAL;
	}

	cb_stats.run++;
	return 0;
}

int node_stop(struct step_measurement *mes, uint32_t handle, uint32_t inst)
{
	/* Fires when the node has been successfully run. */
	cb_stats.stop++;

	return 0;
}

void node_error(struct step_measurement *mes, uint32_t handle,
		uint32_t inst, int error)
{
	/* Fires when an error occurs running this node. */
	cb_stats.error++;
}

/* Processor node chain. */
struct step_node test_node_chain_data[] = {
	/* Root processor node. */
	{
		.name = "Root processor node (temp)",
		.filters = {
			.count = 3,
			.chain = (struct step_filter[]){
				{
					/* Temperature (base type). */
					.match = STEP_MES_TYPE_TEMPERATURE,
					.ignore_mask = ~STEP_MES_MASK_FULL_TYPE,
				},
				{
					/* Die temperature. */
					.op = STEP_FILTER_OP_OR,
					.match = STEP_MES_TYPE_TEMPERATURE +
						 (STEP_MES_EXT_TYPE_TEMP_DIE <<
						  STEP_MES_MASK_EXT_TYPE_POS),
					.ignore_mask = ~STEP_MES_MASK_FULL_TYPE,
				},
				{
					/* Make sure timestamp (bits 26-28) = EPOCH32 */
					.op = STEP_FILTER_OP_AND,
					.match = (STEP_MES_TIMESTAMP_EPOCH_32 <<
						  STEP_MES_MASK_TIMESTAMP_POS),
					.ignore_mask = ~STEP_MES_MASK_TIMESTAMP,
				},
			},
		},

		/* Callbacks */
		.callbacks = {
			.evaluate_handler = NULL,
			.matched_handler = node_matched,
			.start_handler = node_start,
			.stop_handler = node_stop,
			.exec_handler = node_exec,
			.error_handler = node_error,
		},

		/* Config settings */
		.config = NULL,

		/* Point to next processor node in chain. */
		.next = &test_node_chain_data[1]
	},

	/* Processor node 1. */
	{
		.name = "2nd processor node",
		/* Callbacks */
		.callbacks = {
			.exec_handler = node_exec,
			.error_handler = node_error,
		},

		/* Config settings (multiplication factor) */
		.config = &node_cfg_inst,

		/* Point to next processor node in chain. */
		.next = &test_node_chain_data[2]
	},

	/* Processor node 2. */
	{
		.name = "3rd processor node",
		/* Callbacks */
		.callbacks = {
			.exec_handler = node_exec,
			.error_handler = node_error,
		},

		/* Config settings */
		.config = NULL,

		/* End of the chain. */
		.next = NULL
	}
};

/* Pointer to node chain. */
struct step_node *test_node_chain = test_node_chain_data;
```

## src/pnodes.h
```c
/*
 * Copyright (c) 2021 Linaro
 *
 * SPDX-License-Identifier: Apache-2.0
 */

#ifndef STEP_SHELL_PNODES_H__
#define STEP_SHELL_PNODES_H__

#include <stdlib.h>
#include <stdbool.h>
#include <step/step.h>
#include <step/node.h>
#include <step/measurement/measurement.h>

#ifdef __cplusplus
extern "C" {
#endif

/* Struct to track the number of times specific callbacks are fired. */
struct step_node_cb_stats {
	uint32_t evaluate;
	uint32_t matched;
	uint32_t start;
	uint32_t run;
	uint32_t stop;
	uint32_t error;
};

/* Defined in pnodes.c */
extern struct step_node_cb_stats cb_stats;
extern struct step_node *test_node_chain;

#ifdef __cplusplus
}
#endif

#endif /* STEP_SHELL_PNODES_H_ */
```

## src/procnodes.c
```c
/*
 * Copyright (c) 2021 Linaro
 *
 * SPDX-License-Identifier: Apache-2.0
 */

#include <stdio.h>
#include <logging/log.h>
#include <step/proc_mgr.h>
#include "procnodes.h"
#include "driver.h"

LOG_MODULE_DECLARE(step_shell);

struct step_node_cb_stats cb_stats = { 0 };

/* Demonstrate how a custom config struct can be used with node callbacks. */
struct node_cfg {
	float mult;
} node_cfg_inst = {
	.mult = 10.0F,
};

/* Overrides the filter engine when evaluating this node. */
bool node_evaluate(struct step_measurement *mes, uint32_t handle, uint32_t inst)
{
	cb_stats.evaluate++;

	return true;
}

/* Fires when the filter engine has indicated a match for this node. */
bool node_matched(struct step_measurement *mes, uint32_t handle, uint32_t inst)
{
	cb_stats.matched++;

	return true;
}

/* Fires before the node runs. */
int node_start(struct step_measurement *mes, uint32_t handle, uint32_t inst)
{
	cb_stats.start++;

	return 0;
}

/* Main node processing function. */
int node_exec(struct step_measurement *mes, uint32_t handle, uint32_t inst)
{
	struct step_node *node;

	if (mes->header.filter.ext_type == STEP_MES_EXT_TYPE_TEMP_DIE) {
		float mult = 1.0F;

		/* Get a reference to the source node from the proc. node registry. */
		node = step_pm_node_get(handle, inst);
		if (node == NULL) {
			return -EINVAL;
		}

		/* Parse the config struct if present. */
		if (node->config != NULL) {
			struct node_cfg *c = node->config;
			mult = c->mult;
			LOG_INF("cfg: mult by %.2f (handle %d:%d)", c->mult, handle, inst);
		}

		/* Display the timestamp and die temp value. */
		struct drv_payload *tp = mes->payload;
		tp->temp_c *= mult;
		LOG_INF("[%d] Received die temp: %0.2f C (handle %d:%d)",
			tp->timestamp, tp->temp_c, handle, inst);
	} else {
		LOG_WRN("Unexpected message type: base=%02X ext=%02X, handle %d:%d",
			mes->header.filter.base_type, mes->header.filter.ext_type,
			handle, inst);
		return -EINVAL;
	}

	cb_stats.run++;
	return 0;
}

/* Fires when the node has been successfully run. */
int node_stop(struct step_measurement *mes, uint32_t handle, uint32_t inst)
{
	cb_stats.stop++;

	return 0;
}

/* Fires when an error occurs running this node. */
void node_error(struct step_measurement *mes, uint32_t handle,
		uint32_t inst, int error)
{
	cb_stats.error++;
}

/* Processor node chain. */
struct step_node test_node_chain_data[] = {
	/* Root processor node. */
	{
		.name = "Root processor node",
		.filters = {
			.count = 3,
			.chain = (struct step_filter[]){
				{
					/* Temperature (base type). */
					.match = STEP_MES_TYPE_TEMPERATURE,
					.ignore_mask = ~STEP_MES_MASK_FULL_TYPE,
				},
				{
					/* Die temperature. */
					.op = STEP_FILTER_OP_OR,
					.match = STEP_MES_TYPE_TEMPERATURE +
						 (STEP_MES_EXT_TYPE_TEMP_DIE <<
						  STEP_MES_MASK_EXT_TYPE_POS),
					.ignore_mask = ~STEP_MES_MASK_FULL_TYPE,
				},
				{
					/* Make sure timestamp (bits 26-28) = UPTIME_MS_32 */
					.op = STEP_FILTER_OP_AND,
					.match = (STEP_MES_TIMESTAMP_UPTIME_MS_32 <<
						  STEP_MES_MASK_TIMESTAMP_POS),
					.ignore_mask = ~STEP_MES_MASK_TIMESTAMP,
				},
			},
		},

		/* Callbacks */
		.callbacks = {
			.evaluate_handler = NULL,
			.matched_handler = node_matched,
			.start_handler = node_start,
			.stop_handler = node_stop,
			.exec_handler = node_exec,
			.error_handler = node_error,
		},

		/* Config settings */
		.config = NULL,

		/* Point to next processor node in chain. */
		.next = &test_node_chain_data[1]
	},

	/* Processor node 1. */
	{
		.name = "2nd processor node",
		/* Callbacks */
		.callbacks = {
			.exec_handler = node_exec,
			.error_handler = node_error,
		},

		/* Config settings (multiplication factor) */
		.config = &node_cfg_inst,

		/* Point to next processor node in chain. */
		.next = &test_node_chain_data[2]
	},

	/* Processor node 2. */
	{
		.name = "3rd processor node",
		/* Callbacks */
		.callbacks = {
			.exec_handler = node_exec,
			.error_handler = node_error,
		},

		/* Config settings */
		.config = NULL,

		/* End of the chain. */
		.next = NULL
	}
};

/* Pointer to node chain. */
struct step_node *test_node_chain = test_node_chain_data;
```

## src/procnodes.h
```c
/*
 * Copyright (c) 2021 Linaro
 *
 * SPDX-License-Identifier: Apache-2.0
 */

#ifndef STEP_SHELL_PROCNODES_H__
#define STEP_SHELL_PROCNODES_H__

#include <stdlib.h>
#include <stdbool.h>
#include <step/step.h>
#include <step/node.h>
#include <step/measurement/measurement.h>

#ifdef __cplusplus
extern "C" {
#endif

/* Struct to track the number of times specific callbacks are fired. */
struct step_node_cb_stats {
	uint32_t evaluate;
	uint32_t matched;
	uint32_t start;
	uint32_t run;
	uint32_t stop;
	uint32_t error;
};

/* Defined in pnodes.c */
extern struct step_node_cb_stats cb_stats;
extern struct step_node *test_node_chain;

#ifdef __cplusplus
}
#endif

#endif /* STEP_SHELL_PROCNODES_H_ */
```
