## CMakeLists.txt
```
cmake_minimum_required(VERSION 3.13.1)
find_package(Zephyr)
project(step)

zephyr_include_directories($ENV{ZEPHYR_BASE}/kernel/include/)

FILE(GLOB app_sources src/*.c)
target_sources(app PRIVATE ${app_sources})
```

## prj.conf
```kconfig
CONFIG_ZTEST=y
CONFIG_ZTEST_NEW_API=y
CONFIG_NEWLIB_LIBC=y
CONFIG_ZTEST_STACK_SIZE=2048

CONFIG_STEP=y
CONFIG_STEP_PROC_MGR_NODE_LIMIT=4
CONFIG_STEP_PROC_MGR_PRIORITY=-1
```

## src/main.c
```c
/*
 * Copyright (c) 2021 Linaro
 *
 * SPDX-License-Identifier: Apache-2.0
 */

#include <ztest.h>

/* tests_meas.c */
extern void test_mes_check_header(void);
extern void test_mes_check_payload(void);
extern void test_mes_check_sample_count(void);
extern void test_mes_check_payload_sz(void);

/* tests_filter.c */
extern void test_filter_evaluate_fc_null(void);
extern void test_filter_evaluate_mes_null(void);
extern void test_filter_evaluate_fc_len(void);
extern void test_filter_evaluate_fc_bad_op0(void);
extern void test_filter_evaluate_match_good(void);
extern void test_filter_evaluate_match_bad(void);

/* tests_proc.c */
extern void test_proc_reg_limit(void);
extern void test_proc_manual(void);
extern void test_proc_manual_non_alloc(void);
extern void test_proc_thread(void);
extern void test_proc_get_node(void);
extern void test_proc_subscribe_node_chain(void);
extern void test_proc_subscribe_node_chain_multiple_callbacks(void);
extern void test_proc_subscribe_multiple_node_chain_multiple_callbacks(void);

/* tests_sample_pool.c */
extern void test_sp_alloc(void);
extern void test_sp_alloc_limit(void);
extern void test_sp_fifo(void);

void test_main(void)
{
	ztest_test_suite(step_tests,
		ztest_unit_test(test_mes_check_header),
		ztest_unit_test(test_mes_check_payload),
		ztest_unit_test(test_mes_check_sample_count),
		ztest_unit_test(test_mes_check_payload_sz),

		ztest_unit_test(test_filter_evaluate_fc_null),
		ztest_unit_test(test_filter_evaluate_mes_null),
		ztest_unit_test(test_filter_evaluate_fc_len),
		ztest_unit_test(test_filter_evaluate_fc_bad_op0),
		ztest_unit_test(test_filter_evaluate_match_good),
		ztest_unit_test(test_filter_evaluate_match_bad),

		ztest_unit_test(test_proc_reg_limit),
		ztest_unit_test(test_proc_manual),
		ztest_unit_test(test_proc_manual_non_alloc),
		ztest_unit_test(test_proc_thread),
		ztest_unit_test(test_proc_get_node),
		ztest_unit_test(test_proc_subscribe_node_chain),
		ztest_unit_test(test_proc_subscribe_node_chain_multiple_callbacks),
		ztest_unit_test(test_proc_subscribe_multiple_node_chain_multiple_callbacks),
		
		ztest_unit_test(test_sp_alloc),
		ztest_unit_test(test_sp_alloc_limit),
		ztest_unit_test(test_sp_fifo)
	);

	/* Test suites. */
	ztest_run_test_suite(step_tests);
}
```

## src/data.c
```c
/*
 * Copyright (c) 2021 Linaro
 *
 * SPDX-License-Identifier: Apache-2.0
 */

#include <zephyr/ztest.h>
#include <step/step.h>
#include <step/filter.h>
#include <step/measurement/measurement.h>
#include <step/node.h>
#include "data.h"

/* Track callback entry statistics. */
struct step_test_data_procnode_cb_stats step_test_data_cb_stats = { 0 };

int data_node_init(void *cfg, uint32_t handle, uint32_t inst)
{
	step_test_data_cb_stats.init++;

	return 0;
}

bool data_node_evaluate(struct step_measurement *mes, uint32_t handle,
			uint32_t inst)
{
	/* Overrides the filter engine when evaluating this node. */
	step_test_data_cb_stats.evaluate++;

	return true;
}

bool data_node_matched(struct step_measurement *mes, uint32_t handle,
		       uint32_t inst)
{
	/* Fires when the filter engine has indicated a match for this node. */
	step_test_data_cb_stats.matched++;

	return true;
}

int data_node_start(struct step_measurement *mes, uint32_t handle,
		    uint32_t inst)
{
	/* Fires before the node runs. */
	step_test_data_cb_stats.start++;

	return 0;
}

int data_node_exec(struct step_measurement *mes, uint32_t handle,
		   uint32_t inst)
{
	/* Node logic implementation. */
	step_test_data_cb_stats.run++;

	return 0;
}

int data_node_stop(struct step_measurement *mes, uint32_t handle,
		   uint32_t inst)
{
	/* Fires when the node has been successfully run. */
	step_test_data_cb_stats.stop++;

	return 0;
}

void data_node_error(struct step_measurement *mes, uint32_t handle,
		     uint32_t inst, int error)
{
	/* Fires when an error occurs running this node. */
	step_test_data_cb_stats.error++;
}

/* Processor node chain. */
static struct step_node step_test_data_procnode_chain_data[] = {
	/* Processor node 0. */
	{
		.name = "Temperature chain",

		/* Temperature filter. */
		.filters = {
			.count = 3,
			.chain = (struct step_filter[]){
				{
					/* Temperature (base type). */
					.match = STEP_MES_TYPE_TEMPERATURE,
					.ignore_mask = ~STEP_MES_MASK_FULL_TYPE,
				},
				{
					/* Die temperature. */
					.op = STEP_FILTER_OP_OR,
					.match = STEP_MES_TYPE_TEMPERATURE +
						 (STEP_MES_EXT_TYPE_TEMP_DIE <<
						  STEP_MES_MASK_EXT_TYPE_POS),
					.ignore_mask = ~STEP_MES_MASK_FULL_TYPE,
				},
				{
					/* Make sure timestamp (bits 26-28) = EPOCH32 */
					.op = STEP_FILTER_OP_AND,
					.match = (STEP_MES_TIMESTAMP_EPOCH_32 <<
						  STEP_MES_MASK_TIMESTAMP_POS),
					.ignore_mask = ~STEP_MES_MASK_TIMESTAMP,
				},
			},
		},

		/* Callbacks */
		.callbacks = {
			.init_handler = data_node_init,
			.evaluate_handler = NULL,
			.matched_handler = data_node_matched,
			.start_handler = data_node_start,
			.stop_handler = data_node_stop,
			.exec_handler = data_node_exec,
			.error_handler = data_node_error,
		},

		/* Config settings */
		.config = NULL,

		/* Point to next processor node in chain. */
		.next = &step_test_data_procnode_chain_data[1]
	},
	/* Processor node 1. */
	{
		.name = "Secondary node",

		/* Callbacks */
		.callbacks = {
			.init_handler = data_node_init,
			.evaluate_handler = data_node_evaluate,
			.matched_handler = data_node_matched,
			.start_handler = data_node_start,
			.stop_handler = data_node_stop,
			.exec_handler = data_node_exec,
			.error_handler = data_node_error,
		},

		/* Config settings */
		.config = NULL,

		/* End of the chain. */
		.next = NULL
	}
};

/* Pointer to node chain. */
struct step_node *step_test_data_procnode_chain =
	step_test_data_procnode_chain_data;

/* Single processor node. */
struct step_node step_test_data_procnode = {
	.name = "Temperature",
	/* Matches if DS filter field = 0x26 OR 0x226 AND bit 26 is set. */
	.filters = {
		.count = 3,
		.chain = (struct step_filter[]){
			{
				/* Temperature (base type). */
				.match = STEP_MES_TYPE_TEMPERATURE,
				.ignore_mask = ~STEP_MES_MASK_FULL_TYPE,         /* 0xFFFF0000 */
			},
			{
				/* Die temperature. */
				.op = STEP_FILTER_OP_OR,
				.match = STEP_MES_TYPE_TEMPERATURE +
					 (STEP_MES_EXT_TYPE_TEMP_DIE <<
					  STEP_MES_MASK_EXT_TYPE_POS),
				.ignore_mask = ~STEP_MES_MASK_FULL_TYPE,         /* 0xFFFF0000 */
			},
			{
				/* Make sure timestamp (bits 26-28) = EPOCH32. */
				.op = STEP_FILTER_OP_AND,
				.match = (STEP_MES_TIMESTAMP_EPOCH_32 <<
					  STEP_MES_MASK_TIMESTAMP_POS),
				.ignore_mask = ~STEP_MES_MASK_TIMESTAMP,         /* 0xE3FFFFFF */
			},
		},
	},

	/* Callbacks */
	.callbacks = {
		.init_handler = data_node_init,
		.evaluate_handler = data_node_evaluate,
		.matched_handler = data_node_matched,
		.start_handler = data_node_start,
		.stop_handler = data_node_stop,
		.exec_handler = data_node_exec,
		.error_handler = data_node_error,
	},

	/* Config settings */
	.config = (void *)0x12345678,

	/* Not a chain. */
	.next = NULL
};

/* Die temperature with 32-bit timestamp payload. */
struct {
	uint32_t timestamp;
	float temp_c[4];
} step_test_data_dietemp_payload = {
	.timestamp = 1624305803,         /* Monday, June 21, 2021 8:03:23 PM */
	.temp_c = { 32.0F, 36.0F, 21.0F, -3.6F },
};

/* Test die temp measurement, with timestamp. */
struct step_measurement step_test_mes_dietemp = {
	/* Measurement metadata. */
	.header = {
		/* Filter word. */
		.filter = {
			.base_type = STEP_MES_TYPE_TEMPERATURE,
			.ext_type = STEP_MES_EXT_TYPE_TEMP_DIE,
			.flags = {
				.timestamp = STEP_MES_TIMESTAMP_EPOCH_32,
			},
		},
		/* SI Unit word. */
		.unit = {
			.si_unit = STEP_MES_UNIT_SI_DEGREE_CELSIUS,
			.ctype = STEP_MES_UNIT_CTYPE_IEEE754_FLOAT32,
		},
		/* Source/Len word. */
		.srclen = {
			.samples = 2,   /* 2^2 = 4 samples. */
			.len = sizeof(step_test_data_dietemp_payload),
			.sourceid = 10,
		},
	},

	/* Die temperature in C plus 32-bit epoch timestamp. */
	.payload = &step_test_data_dietemp_payload,
};
```

## src/data.h
```c
/*
 * Copyright (c) 2021 Linaro
 *
 * SPDX-License-Identifier: Apache-2.0
 */

#ifndef ZEPHYR_INCLUDE_STEP_TEST_DATA_H_
#define ZEPHYR_INCLUDE_STEP_TEST_DATA_H_

#include <step/measurement/measurement.h>

struct step_test_data_procnode_cb_stats {
	uint32_t init;
	uint32_t evaluate;
	uint32_t matched;
	uint32_t start;
	uint32_t run;
	uint32_t stop;
	uint32_t error;
};

extern struct step_node *step_test_data_procnode_chain;
extern struct step_node step_test_data_procnode;
extern struct step_measurement step_test_mes_dietemp;
extern struct step_test_data_procnode_cb_stats step_test_data_cb_stats;

#endif /* ZEPHYR_INCLUDE_STEP_TEST_DATA_H_ */
```

## src/floatcheck.c
```c
/*
 * Copyright (c) 2019-2020 Kevin Townsend (KTOWN)
 *
 * SPDX-License-Identifier: Apache-2.0
 */

#include <ctype.h>
#include "floatcheck.h"

bool
val_is_equal(float a, float b, float epsilon)
{
	float c;

	c = a - b;

	if (c < epsilon && -c < epsilon) {
		return 1;
	} else {
		return 0;
	}
}

bool
val_is_at_least(float a, float b)
{
	return a >= b ? 1 : 0;
}

bool
val_is_less_than(float a, float b)
{
	return a < b ? 1 : 0;
}

bool
val_is_greater_than(float a, float b)
{
	return a > b ? 1 : 0;
}

bool
val_is_within(float a, float upper, float lower)
{
	if ((a <= upper) && (a >= lower)) {
		return 1;
	} else {
		return 0;
	}
}
```

## src/floatcheck.h
```c
/*
 * Copyright (c) 2019-2020 Kevin Townsend (KTOWN)
 *
 * SPDX-License-Identifier: Apache-2.0
 */

/**
 * @file
 * @brief Helper functions to test floating point values.
 *
 * This file contains helpers to test floating point values.
 */

#ifndef ZEPHYR_INCLUDE_STEP_FLOATCHECK_H_
#define ZEPHYR_INCLUDE_STEP_FLOATCHECK_H_

#include <zephyr/kernel.h>
#include <stdint.h>

#ifdef __cplusplus
extern "C" {
#endif

/**
 * Checks if a float is equal to the specified value, with a +/- margin of
 * 'epsilon'.
 *
 * @param a         The value to check
 * @param b         The value to compare against
 * @param b         The +/- margin for equality
 *
 * @return  True if value 'a' is equal to 'b', otherwise false.
 */
bool val_is_equal(float a, float b, float epsilon);

/**
 * Checks if a float is equal to or greater than the specified value.
 *
 * @param a         The value to check
 * @param b         The value to compare against
 *
 * @return  True if value 'a' is greater than or equal to 'b', otherwise false.
 */
bool val_is_at_least(float a, float b);

/**
 * Checks if a float is less than the specified value.
 *
 * @param a         The value to check
 * @param b         The value to compare against
 *
 * @return  True if value 'a' is less than 'b', otherwise false.
 */
bool val_is_less_than(float a, float b);

/**
 * Checks if a float is greater than the specified value.
 *
 * @param a         The value to check
 * @param b         The value to compare against
 *
 * @return  True if value 'a' is greater than 'b', otherwise false.
 */
bool val_is_greater_than(float a, float b);

/**
 * Checks if a float is within the range of 'upper' and 'lower'.
 *
 * @param a         The value to check
 * @param upper     The upper value to compare against (inclusive)
 * @param lower     The lower value to compare against (inclusive)
 *
 * @return  True if value 'a' is <= 'upper' and >='lower', otherwise false.
 */
bool val_is_within(float a, float upper, float lower);

#ifdef __cplusplus
}
#endif

#endif /* ZEPHYR_INCLUDE_STEP_FLOATCHECK_H_ */
```

## src/tests_datasample.c
```c
/*
 * Copyright (c) 2021 Linaro
 *
 * SPDX-License-Identifier: Apache-2.0
 */

#include <ztest.h>
#include <sys/printk.h>
#include <sdp/sdp.h>
#include <sdp/datasample.h>
#include "floatcheck.h"
#include "data.h"

void test_ds_check_header(void)
{
	/* Base data type. */
	zassert_equal(sdp_test_data_sample_dietemp.header.filter.data_type,
		      SDP_DS_TYPE_TEMPERATURE, NULL);

	/* Extended data type. */
	zassert_equal(sdp_test_data_sample_dietemp.header.filter.ext_type,
		      SDP_DS_EXT_TYPE_TEMP_DIE, NULL);

	/* Data format. */
	zassert_equal(sdp_test_data_sample_dietemp.header.filter.flags.data_format,
		      SDP_DS_FORMAT_NONE, NULL);

	/* Encoding. */
	zassert_equal(sdp_test_data_sample_dietemp.header.filter.flags.encoding,
		      SDP_DS_ENCODING_NONE, NULL);

	/* Compression. */
	zassert_equal(sdp_test_data_sample_dietemp.header.filter.flags.compression,
		      SDP_DS_COMPRESSION_NONE, NULL);

	/* Timestamp format. */
	zassert_equal(sdp_test_data_sample_dietemp.header.filter.flags.timestamp,
		      SDP_DS_TIMESTAMP_EPOCH_32, NULL);

	/* SI unit type. */
	zassert_equal(sdp_test_data_sample_dietemp.header.unit.si_unit,
		      SDP_DS_UNIT_SI_DEGREE_CELSIUS, NULL);

	/* Ctype. */
	zassert_equal(sdp_test_data_sample_dietemp.header.unit.ctype,
		      SDP_DS_UNIT_CTYPE_IEEE754_FLOAT32, NULL);

	/* Scale factor. */
	zassert_equal(sdp_test_data_sample_dietemp.header.unit.scale_factor,
		      SDP_DS_SI_SCALE_NONE, NULL);

	/* Payload length in bytes. */
	zassert_equal(sdp_test_data_sample_dietemp.header.srclen.len, 8,
		      NULL);

	/* Partial payload packet? */
	zassert_equal(sdp_test_data_sample_dietemp.header.srclen.fragment, 0,
		      NULL);

	/* Sample count. */
	zassert_equal(sdp_test_data_sample_dietemp.header.srclen.samples, 0,
		      NULL);

	/* Source ID from the source manager registry. */
	zassert_equal(sdp_test_data_sample_dietemp.header.srclen.sourceid, 10,
		      NULL);
}

void test_ds_check_payload(void)
{
	struct payload {
		float temp_c;
		uint32_t timestamp;
	} payload;

	/* Check payload length. */
	zassert_equal(sizeof(payload),
		      sdp_test_data_sample_dietemp.header.srclen.len, NULL);

	/* Make a copy of the payload. */
	memcpy(&payload,
	       sdp_test_data_sample_dietemp.payload,
	       sdp_test_data_sample_dietemp.header.srclen.len);

	/* Verify temperature. */
	zassert_true(val_is_equal(payload.temp_c, 32.0F, 0.0001), NULL);

	/* Verify timestamp. */
	zassert_equal(payload.timestamp, 1624305803, NULL);
}
```

## src/tests_filter.c
```c
/*
 * Copyright (c) 2021 Linaro
 *
 * SPDX-License-Identifier: Apache-2.0
 */

#include <zephyr/ztest.h>
#include <zephyr/sys/printk.h>
#include <step/step.h>
#include <step/node.h>
#include <step/filter.h>
#include "floatcheck.h"
#include "data.h"

ZTEST_SUITE(tests_filter, NULL, NULL, NULL, NULL, NULL);

ZTEST(tests_filter, test_filter_evaluate_fc_null)
{
	int rc = 0;
	int match;

	/* Clear callback counter stats. */
	memset(&step_test_data_cb_stats, 0,
	       sizeof(struct step_test_data_procnode_cb_stats));

	/* Filter chain null = catch all, should pass. */
	rc = step_filt_evaluate(
		NULL,
		&step_test_mes_dietemp,
		&match);
	zassert_equal(rc, 0, NULL);

	/* Make sure we have a match. */
	zassert_equal(match, 1, NULL);
}

ZTEST(tests_filter, test_filter_evaluate_mes_null)
{
	int rc = 0;
	int match;

	/* Clear callback counter stats. */
	memset(&step_test_data_cb_stats, 0,
	       sizeof(struct step_test_data_procnode_cb_stats));

	/* Message null = error condition. */
	rc = step_filt_evaluate(
		&(step_test_data_procnode.filters),
		NULL,
		&match);
	zassert_equal(rc, -EINVAL, NULL);

	/* Make sure we have a failed match. */
	zassert_equal(match, 0, NULL);
}

ZTEST(tests_filter, test_filter_evaluate_fc_len)
{
	int rc = 0;
	int match;

	int old_count = step_test_data_procnode.filters.count;

	step_test_data_procnode.filters.count = 0;

	/* Clear callback counter stats. */
	memset(&step_test_data_cb_stats, 0,
	       sizeof(struct step_test_data_procnode_cb_stats));

	/* Filter chain len = 0 means catch all, should pass. */
	rc = step_filt_evaluate(
		&(step_test_data_procnode.filters),
		&step_test_mes_dietemp,
		&match);

	/* Reset count. */
	step_test_data_procnode.filters.count = old_count;

	zassert_equal(rc, 0, NULL);
	zassert_equal(match, 1, NULL);
}

ZTEST(tests_filter, test_filter_evaluate_fc_bad_op0)
{
	int rc = 0;
	int match;

	int old_op = step_test_data_procnode.filters.chain[0].op;

	step_test_data_procnode.filters.chain[0].op = STEP_FILTER_OP_OR_NOT;

	/* Clear callback counter stats. */
	memset(&step_test_data_cb_stats, 0,
	       sizeof(struct step_test_data_procnode_cb_stats));

	/* Filter chain op 0 must be IS or NOT. */
	rc = step_filt_evaluate(
		&(step_test_data_procnode.filters),
		&step_test_mes_dietemp,
		&match);

	/* Reset op. */
	step_test_data_procnode.filters.chain[0].op = old_op;

	zassert_equal(rc, -EINVAL, NULL);
	zassert_equal(match, 0, NULL);
}

ZTEST(tests_filter, test_filter_evaluate_match_good)
{
	int rc = 0;
	int match;

	/* Clear callback counter stats. */
	memset(&step_test_data_cb_stats, 0,
	       sizeof(struct step_test_data_procnode_cb_stats));

	/* Evaluate the die temp sample against the test processor node. */
	rc = step_filt_evaluate(
		&(step_test_data_procnode.filters),
		&step_test_mes_dietemp,
		&match);
	zassert_equal(rc, 0, NULL);

	/* Make sure we have a successful match. */
	zassert_equal(match, 1, NULL);

	// /* Matched callback counter should be 1. */
	// zassert_equal(step_test_data_cb_stats.matched, 1, NULL);
}

ZTEST(tests_filter, test_filter_evaluate_match_bad)
{
	/* TODO */

	zassert_equal(1, 1, NULL);
}
```

## src/tests_meas.c
```c
/*
 * Copyright (c) 2021 Linaro
 *
 * SPDX-License-Identifier: Apache-2.0
 */

#include <zephyr/ztest.h>
#include <zephyr/sys/printk.h>
#include <step/step.h>
#include <step/measurement/measurement.h>
#include "floatcheck.h"
#include "data.h"

ZTEST_SUITE(tests_measurement, NULL, NULL, NULL, NULL, NULL);

ZTEST(tests_measurement, test_mes_check_header)
{
	/* Base data type. */
	zassert_equal(step_test_mes_dietemp.header.filter.base_type,
		      STEP_MES_TYPE_TEMPERATURE, NULL);

	/* Extended data type. */
	zassert_equal(step_test_mes_dietemp.header.filter.ext_type,
		      STEP_MES_EXT_TYPE_TEMP_DIE, NULL);

	/* Data format. */
	zassert_equal(step_test_mes_dietemp.header.filter.flags.data_format,
		      STEP_MES_FORMAT_NONE, NULL);

	/* Encoding. */
	zassert_equal(step_test_mes_dietemp.header.filter.flags.encoding,
		      STEP_MES_ENCODING_NONE, NULL);

	/* Compression. */
	zassert_equal(step_test_mes_dietemp.header.filter.flags.compression,
		      STEP_MES_COMPRESSION_NONE, NULL);

	/* Timestamp format. */
	zassert_equal(step_test_mes_dietemp.header.filter.flags.timestamp,
		      STEP_MES_TIMESTAMP_EPOCH_32, NULL);

	/* SI unit type. */
	zassert_equal(step_test_mes_dietemp.header.unit.si_unit,
		      STEP_MES_UNIT_SI_DEGREE_CELSIUS, NULL);

	/* Ctype. */
	zassert_equal(step_test_mes_dietemp.header.unit.ctype,
		      STEP_MES_UNIT_CTYPE_IEEE754_FLOAT32, NULL);

	/* Scale factor. */
	zassert_equal(step_test_mes_dietemp.header.unit.scale_factor,
		      STEP_MES_SI_SCALE_NONE, NULL);

	/* Payload length in bytes. */
	zassert_equal(step_test_mes_dietemp.header.srclen.len, 20,
		      NULL);

	/* Partial payload packet? */
	zassert_equal(step_test_mes_dietemp.header.srclen.fragment, 0,
		      NULL);

	/* Sample count (2^2 = 4 samples). */
	zassert_equal(step_test_mes_dietemp.header.srclen.samples, 2,
		      NULL);

	/* Source ID from the source manager registry. */
	zassert_equal(step_test_mes_dietemp.header.srclen.sourceid, 10,
		      NULL);
}

ZTEST(tests_measurement, test_mes_check_payload)
{
	struct payload {
		uint32_t timestamp;
		float temp_c[4];
	} *payload;

	/* Check payload length. */
	zassert_equal(sizeof(struct payload),
		      step_test_mes_dietemp.header.srclen.len, NULL);

	/* Get a reference to the payload. */
	payload = step_test_mes_dietemp.payload;

	/* Verify timestamp. */
	zassert_equal(payload->timestamp, 1624305803, NULL);

	/* Verify temperature. */
	zassert_true(val_is_equal(payload->temp_c[0], 32.0F, 0.0001), NULL);
	zassert_true(val_is_equal(payload->temp_c[1], 36.0F, 0.0001), NULL);
	zassert_true(val_is_equal(payload->temp_c[2], 21.0F, 0.0001), NULL);
	zassert_true(val_is_equal(payload->temp_c[3], -3.6F, 0.0001), NULL);
}

ZTEST(tests_measurement, test_mes_check_sample_count)
{
	int rc;

	rc = step_mes_validate(&step_test_mes_dietemp);
	zassert_ok(rc, NULL);
}

ZTEST(tests_measurement, test_mes_check_payload_sz)
{
	int32_t sz;

	sz = step_mes_sz_payload(&(step_test_mes_dietemp.header));
	zassert_equal(sz, 20, NULL);
}
```

## src/tests_proc.c
```c
/*
 * Copyright (c) 2021 Linaro
 *
 * SPDX-License-Identifier: Apache-2.0
 */

#include <zephyr/ztest.h>
#include <string.h>
#include <zephyr/sys/printk.h>
#include <step/step.h>
#include <step/measurement/measurement.h>
#include <step/node.h>
#include <step/proc_mgr.h>
#include <step/sample_pool.h>
#include "data.h"
#include "floatcheck.h"

ZTEST_SUITE(tests_proc_manager, NULL, NULL, NULL, NULL, NULL);

ZTEST(tests_proc_manager, test_proc_reg_limit)
{
	int rc;
	uint32_t handle;

	/* Clear the node registry. */
	rc = step_pm_clear();
	zassert_equal(rc, 0, NULL);

	/* Register max number of processor nodes. */
	for (int i = 0; i < CONFIG_STEP_PROC_MGR_NODE_LIMIT; i++) {
		rc = step_pm_register(step_test_data_procnode_chain, 0, &handle);
		zassert_equal(rc, 0, NULL);
		zassert_equal(handle, i, NULL);
	}

	/* Try to add one more. */
	rc = step_pm_register(step_test_data_procnode_chain, 0, &handle);
	zassert_equal(rc, -ENOMEM, NULL);
	zassert_equal(handle, -1, NULL);

	/* Clear the node registry. */
	rc = step_pm_clear();
	zassert_equal(rc, 0, NULL);
}

K_SEM_DEFINE(sync, 0, 1);

void on_proc_completed(struct step_measurement *mes, uint32_t handle, void *user)
{
	k_sem_give(&sync);
}

/**
 * @brief This represents a minimal end-to-end workflow allocating, assigning,
 *        queueing, processing and freeing a single step_measurement.
 */
ZTEST(tests_proc_manager, test_proc_manual)
{
	int rc;
	uint32_t handle;

	struct step_measurement *mes;

	/* Clear processor node stats. */
	memset(&step_test_data_cb_stats, 0,
	       sizeof(struct step_test_data_procnode_cb_stats));

	/* Allocate memory for measurement. */
	mes = step_sp_alloc(step_test_mes_dietemp.header.srclen.len);
	zassert_not_null(mes, NULL);

	/* Copy test data into heap-based measurement instance. */
	memcpy(&(mes->header), &(step_test_mes_dietemp.header),
	       sizeof(struct step_mes_header));
	memcpy(mes->payload, step_test_mes_dietemp.payload,
	       step_test_mes_dietemp.header.srclen.len);

	/* Clear the processor node manager. */
	rc = step_pm_clear();
	zassert_equal(rc, 0, NULL);

	/* Register a processor node. */
	rc = step_pm_register(step_test_data_procnode_chain, 0, &handle);
	zassert_equal(rc, 0, NULL);
	zassert_equal(handle, 0, NULL);

	/* subscribe to the registered node */
	rc = step_pm_subscribe_to_node(handle, on_proc_completed, NULL);
	zassert_equal(rc, 0, NULL);

	/* Assign measurement to FIFO. */
	step_pm_put(mes);
	zassert_equal(rc, 0, NULL);

	/* subscribe to the node to make sure the chain was evaluated */
	rc = k_sem_take(&sync, K_MSEC(3000));
	zassert_equal(rc, 0, NULL);

	/* Verify that the processor callbacks have been fired. */
	zassert_equal(step_test_data_cb_stats.init, 2, NULL);
	zassert_equal(step_test_data_cb_stats.evaluate, 0, NULL);
	zassert_equal(step_test_data_cb_stats.matched, 1, NULL);
	zassert_equal(step_test_data_cb_stats.start, 2, NULL);
	zassert_equal(step_test_data_cb_stats.run, 2, NULL);
	zassert_equal(step_test_data_cb_stats.stop, 2, NULL);
	zassert_equal(step_test_data_cb_stats.error, 0, NULL);

	/* Make sure heap memory was freed. */
	zassert_equal(step_sp_bytes_alloc(), 0, NULL);

	/* Clear the node registry. */
	rc = step_pm_clear();
	zassert_equal(rc, 0, NULL);
}

/**
 * @brief This represents a minimal end-to-end workflow assigning,
 *        queueing and processing a single non-allocated (i.e. non-heap-based)
 *        step_measurement.
 */
ZTEST(tests_proc_manager, test_proc_manual_non_alloc)
{
	int rc;
	uint32_t handle;

	/* Point to a statically defined measurement. */
	struct step_measurement *mes = &step_test_mes_dietemp;

	/* Clear processor node stats. */
	memset(&step_test_data_cb_stats, 0,
	       sizeof(struct step_test_data_procnode_cb_stats));

	/* Clear the processor node manager. */
	rc = step_pm_clear();
	zassert_equal(rc, 0, NULL);

	/* Register a processor node. */
	rc = step_pm_register(step_test_data_procnode_chain, 0, &handle);
	zassert_equal(rc, 0, NULL);
	zassert_equal(handle, 0, NULL);

	/* subscribe to the registered node */
	rc = step_pm_subscribe_to_node(handle, on_proc_completed, NULL);
	zassert_equal(rc, 0, NULL);

	/* push the sample to the processor manager */
	rc = step_pm_put(mes);
	zassert_equal(rc, 0, NULL);
	
	/* subscribe to the node to make sure the chain was evaluated */
	rc = k_sem_take(&sync, K_MSEC(3000));
	zassert_equal(rc, 0, NULL);

	/* Verify that the processor callbacks have been fired. */
	zassert_equal(step_test_data_cb_stats.init, 2, NULL);
	zassert_equal(step_test_data_cb_stats.evaluate, 0, NULL);
	zassert_equal(step_test_data_cb_stats.matched, 1, NULL);
	zassert_equal(step_test_data_cb_stats.start, 2, NULL);
	zassert_equal(step_test_data_cb_stats.run, 2, NULL);
	zassert_equal(step_test_data_cb_stats.stop, 2, NULL);
	zassert_equal(step_test_data_cb_stats.error, 0, NULL);

	/* Clear the node registry. */
	rc = step_pm_clear();
	zassert_equal(rc, 0, NULL);
}

/**
 * @brief Tests the if check node API are correct
 */
ZTEST(tests_proc_manager, test_proc_get_node)
{
	int rc;
	uint32_t handle;
	struct step_node *node;

	/* Clear the processor node manager. */
	rc = step_pm_clear();
	zassert_equal(rc, 0, NULL);

	/* Register a processor node. */
	rc = step_pm_register(step_test_data_procnode_chain, 0, &handle);
	zassert_equal(rc, 0, NULL);
	zassert_equal(handle, 0, NULL);

	/* Register a second processor node. */
	rc = step_pm_register(step_test_data_procnode_chain, 0, &handle);
	zassert_equal(rc, 0, NULL);
	zassert_equal(handle, 1, NULL);

	/* Retrieve node 0:0. */
	node = step_pm_node_get(0, 0);
	zassert_not_null(node, NULL);
	zassert_equal(node->name, step_test_data_procnode_chain->name, NULL);

	/* Rerieve node 0:2 (non-existant). */
	node = step_pm_node_get(0, 2);
	zassert_is_null(node, NULL);

	/* Rerieve node 2:0 (non-existant). */
	node = step_pm_node_get(2, 0);
	zassert_is_null(node, NULL);
}

/**
 * @brief Test the subscription of registered node
 */
static struct step_measurement *received_measurement = NULL;
static uint32_t received_handle;
static uint32_t received_user_data;
static uint32_t callback_counts;
static uint32_t callbacks_on_second_node_counts;

void on_node_completed(struct step_measurement *mes, uint32_t handle, void *user)
{
	received_measurement = mes;
	received_handle = handle;
	received_user_data = (uint32_t)user;

	if(handle == 0) {
		callback_counts++;
	} else if(handle == 1) {
		callbacks_on_second_node_counts++;
	}

	k_sem_give(&sync);
}

ZTEST(tests_proc_manager, test_proc_subscribe_node_chain)
{
	int rc;
	uint32_t handle;

	/* Clear the processor node manager. */
	rc = step_pm_clear();
	zassert_equal(rc, 0, NULL);

	/* Register a processor node. */
	rc = step_pm_register(step_test_data_procnode_chain, 0, &handle);
	zassert_equal(rc, 0, NULL);
	zassert_equal(handle, 0, NULL);

	/* subscribe to the registered node */
	rc = step_pm_subscribe_to_node(handle, on_node_completed, (void *)0x12345678);
	zassert_equal(rc, 0, NULL);

	/* Point to a statically defined measurement. */
	struct step_measurement *mes = &step_test_mes_dietemp;

	/* Copy test data into heap-based measurement instance. */
	memcpy(&(mes->header), &(step_test_mes_dietemp.header),
	       sizeof(struct step_mes_header));
	memcpy(mes->payload, step_test_mes_dietemp.payload,
	       step_test_mes_dietemp.header.srclen.len);

	callback_counts	= 0;
	/* Assign measurement to FIFO. */
	rc = step_pm_put(mes);
	zassert_equal(rc, 0, NULL);

	rc = k_sem_take(&sync, K_MSEC(3000));
	zassert_equal(rc, 0, NULL);

	/* compare data sent with received from subscription callback */
	int match = memcmp(received_measurement->payload, mes->payload, step_test_mes_dietemp.header.srclen.len);
	zassert_equal(match, 0, NULL);
	match = memcmp(received_measurement, mes, sizeof(struct step_measurement));
	zassert_equal(match, 0, NULL);
	zassert_equal(handle, received_handle, NULL);
	zassert_equal(received_user_data, 0x12345678, NULL);
	zassert_equal(callback_counts, 1, NULL);
}
```

## src/tests_sample_pool.c
```c
/*
 * Copyright (c) 2021 Linaro
 *
 * SPDX-License-Identifier: Apache-2.0
 */

#include <zephyr/ztest.h>
#include <step/step.h>
#include <step/measurement/measurement.h>
#include <step/sample_pool.h>
#include <step/proc_mgr.h>
#include "floatcheck.h"
#include "data.h"

ZTEST_SUITE(tests_sample_pool, NULL, NULL, NULL, NULL, NULL);

ZTEST(tests_sample_pool, test_sp_alloc)
{
	struct step_measurement *mes;
	struct step_measurement *ref = &step_test_mes_dietemp;
	uint16_t payload_len = step_test_mes_dietemp.header.srclen.len;

	/* Allocate a datasample with an oversized payload buffer. */
	mes = step_sp_alloc(16384);
	zassert_is_null(mes, NULL);

	/* Allocate a datasample with no payload. */
	mes = step_sp_alloc(0);
	zassert_not_null(mes, NULL);
	zassert_true(mes->header.srclen.len == 0, NULL);
	zassert_is_null(mes->payload, NULL);
	zassert_true(step_sp_bytes_alloc() ==
		     sizeof(struct step_measurement) +
		     (8 - (sizeof(struct step_measurement) % 8)), NULL);
	step_sp_free(mes);
	zassert_true(step_sp_bytes_alloc() == 0, NULL);

	/* Allocate a datasample with an appropriate payload buffer. */
	mes = step_sp_alloc(payload_len);
	zassert_not_null(mes, NULL);
	zassert_true(step_sp_bytes_alloc() ==
		     sizeof(struct step_measurement) + payload_len +
		     (8 - ((sizeof(struct step_measurement) + payload_len) % 8)),
		     NULL);

	/* Check payload len. */
	zassert_true(mes->header.srclen.len == payload_len, NULL);

	/* Make sure payload is empty. */
	for (size_t i = 0; i < payload_len; i++) {
		zassert_true(((uint8_t *)mes->payload)[i] == 0, NULL);
	}

	/* Manually fill sample with reference values to test struct definition. */
	mes->header.filter.base_type = ref->header.filter.base_type;
	mes->header.filter.ext_type = ref->header.filter.ext_type;
	mes->header.filter.flags.compression = ref->header.filter.flags.compression;
	mes->header.filter.flags.data_format = ref->header.filter.flags.data_format;
	mes->header.filter.flags.encoding = ref->header.filter.flags.encoding;
	mes->header.filter.flags.timestamp = ref->header.filter.flags.timestamp;
	mes->header.unit.si_unit = ref->header.unit.si_unit;
	mes->header.unit.ctype = ref->header.unit.ctype;
	mes->header.unit.scale_factor = ref->header.unit.scale_factor;
	mes->header.srclen.fragment = ref->header.srclen.fragment;
	mes->header.srclen.samples = ref->header.srclen.samples;
	mes->header.srclen.len = ref->header.srclen.len;
	mes->header.srclen.sourceid = ref->header.srclen.sourceid;

	/* Copy the test payload. */
	memcpy(mes->payload, ref->payload, payload_len);

	/* Compare payload. */
	zassert_mem_equal(mes->payload, ref->payload, payload_len, NULL);

	/* Free sample memory from pool heap. */
	step_sp_free(mes);
	zassert_true(step_sp_bytes_alloc() == 0, NULL);
}

ZTEST(tests_sample_pool, test_sp_alloc_limit)
{
	int rec_size = sizeof(struct step_measurement) +
		       (8 - (sizeof(struct step_measurement) % 8));
	int max_samples = (CONFIG_STEP_POOL_SIZE - sizeof(struct k_heap)) /
			  rec_size;
	struct step_measurement *mes[max_samples];

	zassert_true(step_sp_bytes_alloc() == 0, NULL);

	/* Fill the buffer to the limit. */
	for (int i = 0; i < max_samples - 1; i++) {
		mes[i] = step_sp_alloc(0);
		zassert_not_null(mes[i], NULL);
	}

	zassert_true(step_sp_bytes_alloc() == rec_size * (max_samples - 1), NULL);

	/* Try to allocate one more sample. */
	struct step_measurement *fault_sample = step_sp_alloc(0);
	zassert_is_null(fault_sample, NULL);

	/* Free the allocated samples */
	for (int i = 0; i < max_samples - 1; i++) {
		step_sp_free(mes[i]);
	}
	zassert_true(step_sp_bytes_alloc() == 0, NULL);
}
```
